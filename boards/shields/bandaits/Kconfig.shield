## boards/shields/bandaits/Kconfig.shield
```kconfig
config SHIELD_BANDAITS_LEFT
    def_bool $(shields_list_contains,bandaits_left)
  
config SHIELD_BANDAITS_RIGHT
    def_bool $(shields_list_contains,bandaits_right)
  
```
